## Kconfig
```kconfig
config SNAKE_USE_CUSTOM_COLORSCHEME
    bool "Use custom colorscheme"
    default n

config SNAKE_COLOR_1
    int "Color 1"
    default 50

config SNAKE_COLOR_2
    int "Color 2"
    default 50

config SNAKE_COLOR_3
    int "Color 3"
    default 50
    
config SNAKE_COLOR_4
    int "Color 4"
    default 50
```

## boards/shields/snake_prospector_adapter/Kconfig.shield
```kconfig
config SHIELD_SNAKE_PROSPECTOR_ADAPTER
    def_bool $(shields_list_contains,snake_prospector_adapter)
```
